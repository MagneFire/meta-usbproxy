## conf/distro/usbproxy.conf
```bitbake
require conf/distro/poky.conf

DISTRO = "usbproxy"
DISTRO_NAME = "usb-proxy appliance"
DISTRO_VERSION = "1.0"
MAINTAINER = "usb-proxy appliance"
SDK_VENDOR = "-usbproxysdk"

# BusyBox init + mdev as PID 1 / device manager: no systemd, no udev, no
# sysvinit churn. /etc/inittab respawns usb-proxy directly (see the busybox
# bbappend). This is the fastest, smallest init for a single-purpose appliance.
INIT_MANAGER = "mdev-busybox"

# Force the device manager to BusyBox mdev. INIT_MANAGER's include only sets this
# as a weak default (??=), which loses to packagegroup-core-boot's own
# `VIRTUAL-RUNTIME_dev_manager ?= "udev"` — so without this hard assignment the
# boot packagegroup silently RDEPENDS udev and drags eudev -> kmod -> libcrypto
# (OpenSSL, ~3MB) + libblkid into the image. We use mdev + devtmpfs, never udevd.
VIRTUAL-RUNTIME_dev_manager = "busybox-mdev"

# Single-purpose USB proxy: strip wireless / graphics / audio / network-service
# stacks. We keep ipv4/ipv6 as a harmless libc/kernel capability but install no
# networking daemons and bring up no interfaces, so boot never waits on network.
DISTRO_FEATURES:remove = "wifi bluetooth nfc 3g x11 wayland vulkan opengl gles2 \
                          alsa pulseaudio bluez5 nfs zeroconf irda"

# Headless single-purpose appliance: drop machine features that only pull
# userspace bloat into the image. "keyboard" drags in keymaps -> kbd ->
# update-alternatives-opkg; the rest have no userspace we ship. (rtc/serial/
# usbgadget/usbhost are kept.)
MACHINE_FEATURES:remove = "keyboard alsa apm screen qemu-usermode vfat"

# Never ship a package manager on the device.
DISTRO_FEATURES_BACKFILL_CONSIDERED += "pulseaudio"
PACKAGE_CLASSES ?= "package_ipk"

# Keep the feed/config tidy; appliance has no use for these.
DISTRO_FEATURES_BACKFILL_CONSIDERED += "gobject-introspection-data"
```

## conf/layer.conf
```bitbake
# meta-usbproxy — minimal read-only USB-proxy appliance layer for Orange Pi Zero
BBPATH .= ":${LAYERDIR}"

BBFILES += "${LAYERDIR}/recipes-*/*/*.bb \
            ${LAYERDIR}/recipes-*/*/*.bbappend"

BBFILE_COLLECTIONS += "usbproxy"
BBFILE_PATTERN_usbproxy = "^${LAYERDIR}/"
BBFILE_PRIORITY_usbproxy = "20"

# Depends on OE-Core ("core") and meta-sunxi ("sunxi"). meta-sunxi in turn pulls
# in meta-oe / meta-python / meta-arm (see README for the full bblayers set).
LAYERDEPENDS_usbproxy = "core sunxi"
LAYERSERIES_COMPAT_usbproxy = "scarthgap"

# This layer ships a distro.
LAYERVERSION_usbproxy = "1"
```
